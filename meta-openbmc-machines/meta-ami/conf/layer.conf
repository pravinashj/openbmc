## meta-openbmc-machines/meta-ami/conf/layer.conf
```bitbake
# We have a conf and classes directory, add to BBPATH
BBPATH .= ":${LAYERDIR}"

# We have recipes-* directories, add to BBFILES
BBFILES += "${LAYERDIR}/common/recipes-*/*/*.bb \
            ${LAYERDIR}/common/recipes-*/*/*.bbappend"

BBFILE_COLLECTIONS += "ami"
BBFILE_PATTERN_ami = "^${LAYERDIR}/"
BBFILE_PRIORITY_ami = "6"
```

## meta-openbmc-machines/meta-ami/meta-olympus/conf/machine/olympus.conf
```bitbake
KMACHINE = "aspeed"
KERNEL_DEVICETREE = "${KMACHINE}-bmc-opp-palmetto.dtb"

require conf/machine/include/ast2400.inc
require conf/machine/include/obmc-bsp-common.inc

UBOOT_MACHINE_olympus = "ast_g4_phy_config"
UBOOT_ENTRYPOINT = "0x40008000"
UBOOT_LOADADDRESS = "0x40008000"

FLASH_SIZE = "32768"

PHOSPHOR_MRW_URI = "git://github.com/open-power/palmetto-xml"
PHOSPHOR_MRW_REV = "82818682f2c2009c30d700df6d5f8897a3096e4f"

OBMC_MACHINE_FEATURES += "\
	obmc-phosphor-fan-mgmt \
	obmc-phosphor-chassis-mgmt \
	obmc-phosphor-flash-mgmt \
	obmc-host-ipmi \
	obmc-host-ctl \
	obmc-host-state-mgmt \
	obmc-chassis-state-mgmt \
	obmc-bmc-state-mgmt \
	"

VIRTUAL-RUNTIME_skeleton_workbook = "${MACHINE}-config"

PREFERRED_PROVIDER_virtual/obmc-chassis-mgmt = "packagegroup-op-apps"
PREFERRED_PROVIDER_virtual/obmc-fan-mgmt = "packagegroup-op-apps"
PREFERRED_PROVIDER_virtual/obmc-flash-mgmt = "packagegroup-op-apps"
PREFERRED_PROVIDER_virtual/obmc-system-mgmt = "packagegroup-op-apps"
PREFERRED_PROVIDER_virtual/obmc-inventory-data = "obmc-inventory"
PREFERRED_PROVIDER_virtual/phosphor-ipmi-fru-inventory = "olympus-ipmi-inventory-map-native"
PREFERRED_PROVIDER_virtual/obmc-host-ipmi-hw = "phosphor-ipmi-bt"
PREFERRED_PROVIDER_virtual/obmc-host-ctl ?= "obmc-op-control-host"
PREFERRED_PROVIDER_virtual/obmc-inventory-data ?= "${VIRTUAL-RUNTIME_skeleton_workbook}"
```

## meta-openbmc-machines/meta-openpower/meta-ibm/meta-palmetto/conf/layer.conf
```bitbake
# We have a conf and classes directory, add to BBPATH
BBPATH .= ":${LAYERDIR}"

# We have recipes-* directories, add to BBFILES
BBFILES += "${LAYERDIR}/recipes-*/*/*.bb \
            ${LAYERDIR}/recipes-*/*/*.bbappend"

BBFILE_COLLECTIONS += "palmetto"
BBFILE_PATTERN_palmetto = ""
IMAGE_INSTALL_append = " luajit redis"
```
